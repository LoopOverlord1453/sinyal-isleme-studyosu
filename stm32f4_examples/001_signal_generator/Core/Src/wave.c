/*
 * Signal Processing Toolbox — DAC dalga tablosu "wave"
 * Dalga: Çoklu ton, 1 kHz + 3 kHz + 6 kHz, genlik 1.80984 V, ofset 1.6496 V
 * Hedef: STM32 HAL — DAC + TIM6 TRGO + DMA dairesel
 * Tablo: N = 250 örnek, M = 1 periyot; fs = 250 kHz → f = M·fs/N = 1000 Hz (istenen 1000 Hz, hata +0.000 ppm)
 * DAC: 12 bit, İşaretsiz (0 … 2^b−1), sağa hizalı, uint16_t; 0 … 3.3 V, 1 LSB = 0.805664 mV
 * Bellek: tablo 500 bayt (const → flash)
 * Bu dosya otomatik üretilmiştir; elle değiştirmeyin, aracı yeniden çalıştırın.
 */
#include "wave.h"

#ifndef WAVE_TABLE_IN_RAM
#define WAVE_TABLE_QUAL const   /* const: tablo flash'ta (bağlayıcı .rodata'ya koyar) */
#else
#define WAVE_TABLE_QUAL         /* -DWAVE_TABLE_IN_RAM: tablo RAM'de (DMA flash'a erişemiyorsa) */
#endif

static WAVE_TABLE_QUAL wave_word_t wave_table_data[WAVE_TABLE_LEN] = {
    0x07FF, 0x0870, 0x08E0, 0x094D, 0x09B6, 0x0A1B, 0x0A7B, 0x0AD3, 0x0B25, 0x0B6E, 0x0BB0, 0x0BE8,
    0x0C18, 0x0C3E, 0x0C5C, 0x0C71, 0x0C7F, 0x0C85, 0x0C84, 0x0C7D, 0x0C70, 0x0C60, 0x0C4C, 0x0C35,
    0x0C1D, 0x0C05, 0x0BED, 0x0BD5, 0x0BC0, 0x0BAD, 0x0B9D, 0x0B91, 0x0B88, 0x0B82, 0x0B81, 0x0B82,
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    0x044F, 0x0491, 0x04DA, 0x052C, 0x0584, 0x05E4, 0x0649, 0x06B2, 0x071F, 0x078F,
};
const wave_word_t *const wave_table = wave_table_data;

uint32_t wave_arr_for_hz(double hz)
{
    double a;
    if (!(hz > 0.0)) {
        return WAVE_TIM_ARR_MAX;
    }
    a = WAVE_TIM_CLOCK_HZ * (double)WAVE_PERIODS
        / ((double)(WAVE_TIM_PSC + 1u) * (double)WAVE_N * hz) + 0.5;
    if (a >= (double)WAVE_TIM_ARR_MAX + 1.0) {
        return WAVE_TIM_ARR_MAX;
    }
    if (a < 2.0) {
        return 1u;
    }
    return (uint32_t)a - 1u;
}

#if defined(USE_HAL_DRIVER)
/* CubeMX: DAC tetik = 'Timer 6 Trigger Out event'; TIM6 TRGO = Update Event; DMA dairesel. */
HAL_StatusTypeDef wave_start(DAC_HandleTypeDef *hdac, TIM_HandleTypeDef *htim)
{
    HAL_StatusTypeDef st;
    __HAL_TIM_SET_PRESCALER(htim, WAVE_TIM_PSC);
    __HAL_TIM_SET_AUTORELOAD(htim, WAVE_TIM_ARR);
    __HAL_TIM_SET_COUNTER(htim, 0u);
    htim->Instance->EGR = TIM_EGR_UG;   /* PSC'yi hemen yükle (DAC henüz kapalı) */
    st = HAL_DAC_Start_DMA(hdac, WAVE_HAL_DAC_CHANNEL, (uint32_t *)(uintptr_t)wave_table_data,
                           WAVE_N, WAVE_HAL_DAC_ALIGN);
    if (st != HAL_OK) {
        return st;
    }
    return HAL_TIM_Base_Start(htim);
}

HAL_StatusTypeDef wave_stop(DAC_HandleTypeDef *hdac, TIM_HandleTypeDef *htim)
{
    (void)HAL_TIM_Base_Stop(htim);
    return HAL_DAC_Stop_DMA(hdac, WAVE_HAL_DAC_CHANNEL);
}

/* ARR önyükleme (ARPE) açıksa değişiklik bir sonraki güncellemede, kesintisiz uygulanır. */
void wave_set_arr(TIM_HandleTypeDef *htim, uint32_t arr)
{
    __HAL_TIM_SET_AUTORELOAD(htim, arr);
}
#endif /* USE_HAL_DRIVER */
